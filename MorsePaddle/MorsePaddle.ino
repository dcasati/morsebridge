#include <Arduino.h>
#include "BlePaddleKeyboard.h"

#if !ARDUINO_USB_CDC_ON_BOOT || ARDUINO_USB_MODE != 1
#error "Enable USB CDC On Boot and select Hardware CDC and JTAG"
#endif

namespace {
constexpr uint8_t ditPin = 4;
constexpr uint8_t dahPin = 5;
bool startupFailed = false;
bool statusLogged = false;
MorseBle::Status lastStatus = MorseBle::Status::Waiting;

void logStatus() {
  const auto status = startupFailed ? MorseBle::Status::Error : MorseBle::status();
  if (statusLogged && status == lastStatus) return;
  statusLogged = true;
  lastStatus = status;
  switch (status) {
    case MorseBle::Status::Waiting:
      Serial.println("Status: waiting for iPhone; pair with Morse Paddle");
      break;
    case MorseBle::Status::Connecting:
      Serial.println("Status: connected, waiting for HID subscription or resume");
      break;
    case MorseBle::Status::ReleasePaddles:
      Serial.println("Status: release BOTH paddles to arm");
      break;
    case MorseBle::Status::Ready:
      Serial.println("Status: ready; timing and sidetone are generated by Morse-it");
      break;
    case MorseBle::Status::Error:
      Serial.println("Status: ERROR; inspect BLE messages, then reset/power-cycle");
      break;
  }
}
}

void setup() {
  pinMode(ditPin, INPUT_PULLUP);
  pinMode(dahPin, INPUT_PULLUP);
  Serial.begin(115200);
  Serial.setTxTimeoutMs(0);  // No USB host is required; never wait for log delivery.
  Serial.println("Morse Paddle: Waveshare ESP32-S3-Zero; BLE HID only");
  Serial.println("Inputs: dit GPIO4, dah GPIO5, active LOW; debounce 5 ms");
  startupFailed = !MorseBle::begin();
  logStatus();
}

void loop() {
  if (!startupFailed) {
    MorseBle::update(digitalRead(ditPin) == LOW, digitalRead(dahPin) == LOW);
  }
  logStatus();
  delay(1);
}
